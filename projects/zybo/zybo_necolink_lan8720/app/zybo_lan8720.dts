/dts-v1/; /plugin/;

/ {
    fragment@0 {  
        target = <&fpga_full>;
        __overlay__ {
            #address-cells = <1>;
            #size-cells = <1>;

            firmware-name = "zybo_lan8720.bit.bin";
        };
    };

    fragment@1 {
        target-path = "/amba";
        __overlay__ {
            fclk0 {
                compatible  = "ikwzm,fclkcfg-0.10.a";
                clocks      = <&clkc 15>;
                insert-rate = "100000000";
            };
        };
    };

    fragment@2 {
        target-path = "/amba";
        __overlay__ {
            #address-cells = <0x1>;
            #size-cells = <0x1>;
            
            uio_pl_peri {
                compatible = "generic-uio";
                reg = <0x40000000 0x10000000>;
            };

//            udmabuf0 {
//                compatible = "ikwzm,udmabuf-0.10.a";
//                minor-number = <0>;
//                size = <0x03000000>;
//            };
        };
    };
};


