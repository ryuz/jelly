/dts-v1/; /plugin/;

/ {
    fragment@0 {  
        target = <&fpga_full>;
        #address-cells = <1>;
        #size-cells = <1>;
  
        __overlay__ {
            #address-cells = <1>;
            #size-cells = <1>;
  
            firmware-name = "zybo_z7_udmabuf_sample.bit.bin";
        };
    };

    fragment@2 {
        target-path = "/amba";
        __overlay__ {
            #address-cells = <0x1>;
            #size-cells = <0x1>;
            
            uio_pl_peri {
                compatible = "generic-uio";
                reg = <0x43c00000 0x00100000>;
            };

            udmabuf4 {
                compatible = "ikwzm,udmabuf-0.10.a";
                minor-number = <4>;
                size = <0x00400000>;
            };
        };
    };
};


