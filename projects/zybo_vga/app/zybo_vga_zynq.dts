/dts-v1/; /plugin/;

/ {
    fragment@0 {  
        target = <&fpga_full>;
        __overlay__ {
            #address-cells = <1>;
            #size-cells = <1>;

            firmware-name = "zybo_vga_zynq.bit.bin";
        };
    };

    /*
    fragment@1 {
        target-path = "/amba";
        __overlay__ {
            #address-cells = <0x1>;
            #size-cells = <0x1>;
            
            uio_pl_peri {
                compatible = "generic-uio";
                reg = <0x43c00000 0x00100000>;
            };

            udmabuf4 {
                compatible = "ikwzm,u-dma-buf";
                minor-number = <4>;
                size = <0x00400000>;
            };
        };
    };
    */
};

